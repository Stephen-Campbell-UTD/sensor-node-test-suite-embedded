/**
 * @cliArgs --board "/ti/boards/LP_CC1352P7_1" --rtos "tirtos" --product "simplelink_cc13xx_cc26xx_sdk@5.40.00.40"
 * @versions {"tool":"1.11.0+2225"}
 */

/**
 * Import the modules used in this configuration.
 */
const ADCBuf  = scripting.addModule("/ti/drivers/ADCBuf", {}, false);
const ADCBuf1 = ADCBuf.addInstance();
const GPIO    = scripting.addModule("/ti/drivers/GPIO", {}, false);
const GPIO8   = GPIO.addInstance();
const UART2   = scripting.addModule("/ti/drivers/UART2", {}, false);
const UART21  = UART2.addInstance();
const Button  = scripting.addModule("/ti/drivers/apps/Button");
const Button1 = Button.addInstance();
const Button2 = Button.addInstance();
const LED     = scripting.addModule("/ti/drivers/apps/LED");
const LED1    = LED.addInstance();
const LED2    = LED.addInstance();

/**
 * Write custom configuration values to the imported modules.
 */
ADCBuf1.$name                             = "CONFIG_ADCBUF_0";
ADCBuf1.acquireADCSem                     = true;
ADCBuf1.timerInstance.$name               = "CONFIG_GPTIMER_0";
ADCBuf1.adcBufChannel0.$name              = "ADCBUF_CHANNEL_0";
ADCBuf1.adcBufChannel0.adc.$assign        = "ADC0";
ADCBuf1.adcBufChannel0.adc.adcPin.$assign = "boosterpack.25";

GPIO8.$name           = "CONFIG_GPIO_PIR";
GPIO8.gpioPin.$assign = "boosterpack.24";

const CCFG              = scripting.addModule("/ti/devices/CCFG", {}, false);
CCFG.ccfgTemplate.$name = "ti_devices_CCFGTemplate0";

UART21.$name     = "CONFIG_UART2_0";
UART21.$hardware = system.deviceData.board.components.XDS110UART;

Button1.$name     = "CONFIG_BUTTON_0";
Button1.$hardware = system.deviceData.board.components["BTN-1"];

Button2.$name     = "CONFIG_BUTTON_1";
Button2.$hardware = system.deviceData.board.components["BTN-2"];

LED1.$name     = "CONFIG_LED_0";
LED1.$hardware = system.deviceData.board.components.LED_RED;

LED2.$name     = "CONFIG_LED_1";
LED2.$hardware = system.deviceData.board.components.LED_GREEN;

/**
 * Pinmux solution for unlocked pins/peripherals. This ensures that minor changes to the automatic solver in a future
 * version of the tool will not impact the pinmux you originally saw.  These lines can be completely deleted in order to
 * re-solve from scratch.
 */
ADCBuf1.adc.$suggestSolution                 = "ADC0";
ADCBuf1.adc.dmaADCChannel.$suggestSolution   = "DMA_CH7";
ADCBuf1.timerInstance.timer.$suggestSolution = "GPTM0";
UART21.uart.$suggestSolution                 = "UART0";
UART21.uart.txPin.$suggestSolution           = "boosterpack.4";
UART21.uart.rxPin.$suggestSolution           = "boosterpack.3";
Button1.button.$suggestSolution              = "boosterpack.13";
Button2.button.$suggestSolution              = "boosterpack.8";
LED1.ledPin.$suggestSolution                 = "boosterpack.39";
LED2.ledPin.$suggestSolution                 = "boosterpack.40";
